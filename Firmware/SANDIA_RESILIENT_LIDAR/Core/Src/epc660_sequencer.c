/*
 * epc660_sequencer.c
 *
 *  Created on: Jan 23, 2026
 *      Author: unrea
 */

#include "epc660_platform.h"
#include "epc660_sequencer.h"
#include "epc660_reg.h"



static const uint8_t sequencer_code[][8] = {			// FORMAT: [RAM_ADDR, D0, D1, D2, D3, D4, D5, SR_PROG]
    {0x00, 0x43, 0x10, 0x00, 0xC0, 0x00, 0x00, 0x0D},	// i2c w 40 00 43 10 00 C0 00 00 0D
    {0x01, 0x43, 0x10, 0x00, 0x00, 0x01, 0x00, 0x0D},	// i2c w 40 01 43 10 00 00 01 00 0D
    {0x02, 0x43, 0x10, 0x00, 0x40, 0x0A, 0x00, 0x0D},	// etc.
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	{0x9C, 0xBD, 0x0E, 0xB0, 0x06, 0x50, 0x00, 0x0D},
};	// END static const uint8_t sequencer_code[][8]


// ----------FUNCTION DEFINITIONS----------
epc_status_t epc660_sequencer_load(void)
{
	epc_status_t status;

	if ((status = epc_i2c_write(0xa4, 0x00, EPC_DIRECT)) != EPC_OK) return status;
	if ((status = epc_i2c_write(0x91, 0x00, EPC_DIRECT)) != EPC_OK) return status;
	if ((status = epc_i2c_write(0x47, 0x01, EPC_DIRECT)) != EPC_OK) return status;


	uint32_t total_rows = sizeof(sequencer_code) / sizeof(sequencer_code[0]);
	for (uint32_t i = 0; i < total_rows; i++)
	{
		status = epc_i2c_write_multi(0x40, sequencer_code[i], 8);

		if (status != EPC_OK)
		{
			return status;
		}
	}

	if ((status = epc_i2c_write(0x47, 0x00, EPC_DIRECT)) != EPC_OK) return status;
	if ((status = epc_i2c_write(0x91, 0x03, EPC_DIRECT)) != EPC_OK) return status;

	return EPC_OK;
}

epc_status_t epc660_sequencer_readback(void)
{
	/*
	 * Reads back the sequencer RAM and compares against the expected
	 * sequencer_code array. Per datasheet section 15.13:
	 *   1. Disable acquisition (0xA4 = 0x00)
	 *   2. Stop sequencer (0x91 = 0x00)
	 *   3. For each RAM address:
	 *      - Write address to 0x40
	 *      - Write 0x09 to 0x47 (enable RAM read access)
	 *      - Read Data0..Data5 from 0x41..0x46
	 *   4. Disable RAM access (0x47 = 0x00)
	 *   5. Restart sequencer (0x91 = 0x03)
	 *
	 * Returns EPC_OK if all bytes match, EPC_ERR if mismatch found.
	 */

	epc_status_t status;
	uint8_t read_data[6];
	uint32_t total_rows = sizeof(sequencer_code) / sizeof(sequencer_code[0]);

	/* 1. Disable acquisition */
	if ((status = epc_i2c_write(0xA4, 0x00, EPC_DIRECT)) != EPC_OK) return status;

	/* 2. Stop sequencer */
	if ((status = epc_i2c_write(0x91, 0x00, EPC_DIRECT)) != EPC_OK) return status;

	/* 3. Read back each RAM address and compare */
	for (uint32_t i = 0; i < total_rows; i++)
	{
		uint8_t ram_addr = sequencer_code[i][0];  /* First byte is RAM address */

		/* Write RAM address to register 0x40 */
		if ((status = epc_i2c_write(0x40, ram_addr, EPC_DIRECT)) != EPC_OK)
		{
			goto cleanup;
		}

		/* Enable RAM read access (0x09 per datasheet) */
		if ((status = epc_i2c_write(0x47, 0x09, EPC_DIRECT)) != EPC_OK)
		{
			goto cleanup;
		}

		/* Read Data0..Data5 from registers 0x41..0x46 */
		for (uint8_t j = 0; j < 6; j++)
		{
			if ((status = epc_i2c_read(0x41 + j, &read_data[j], EPC_DIRECT)) != EPC_OK)
			{
				goto cleanup;
			}
		}

		/* Compare against expected values (bytes 1-6 of sequencer_code row) */
		for (uint8_t j = 0; j < 6; j++)
		{
			if (read_data[j] != sequencer_code[i][j + 1])
			{
				/* Mismatch found */
				status = EPC_ERR;
				goto cleanup;
			}
		}
	}

	status = EPC_OK;

cleanup:
	/* 4. Disable RAM access */
	epc_i2c_write(0x47, 0x00, EPC_DIRECT);

	/* 5. Restart sequencer */
	epc_i2c_write(0x91, 0x03, EPC_DIRECT);

	return status;
}
